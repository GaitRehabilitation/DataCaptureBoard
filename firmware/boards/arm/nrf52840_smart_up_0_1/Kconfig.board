## firmware/boards/arm/nrf52840_smart_up_0_1/Kconfig.board
```kconfig
# Kconfig - nRF52840 SMART_UP_0_1 board configuration
#
# Copyright (c) 2016 Nordic Semiconductor ASA
#
# SPDX-License-Identifier: Apache-2.0

config  BOARD_NRF52840_SMART_UP_0_1
	bool "NRF52840 SMART_UP_0_1"
	depends on SOC_NRF52840_QIAA
```

## firmware/boards/arm/nrf52840_smart_up_0_1/Kconfig.defconfig
```kconfig
# Kconfig - nRF52840 PCA10056 board configuration
#
# Copyright (c) 2016 Nordic Semiconductor ASA
#
# SPDX-License-Identifier: Apache-2.0

if BOARD_NRF52840_SMART_UP_0_1

config BOARD
	default "nrf52840_SMART_UP_0_1"

if ADC

config ADC_0
	default y

endif # ADC

if I2C

endif # I2C

if PWM

config PWM_0
	default y

endif # PWM

if SPI


endif # SPI

if USB

config USB_NRF52840
	default y

config USB_DEVICE_STACK
	default y

endif # USB

if IEEE802154

config IEEE802154_NRF5
	default y

endif # IEEE802154

config BT_CTLR
	default BT

endif # BOARD_NRF52840_SMART_UP_0_1
```

## firmware/boards/arm/nrf52840_smart_up_0_1/nrf52840_smart_up_0_1_defconfig
```kconfig
CONFIG_ARM=y
CONFIG_SOC_FAMILY_NRF=y
CONFIG_SOC_SERIES_NRF52X=y
CONFIG_SOC_NRF52840_QIAA=y
CONFIG_BOARD_NRF52840_SMART_UP_0_1=y

# Enable MPU
CONFIG_ARM_MPU=y

# enable GPIO
CONFIG_GPIO=y

# enable console
#CONFIG_CONSOLE=y
#CONFIG_UART_CONSOLE=y

# additional board options
CONFIG_GPIO_AS_PINRESET=y

CONFIG_I2C=y
CONFIG_I2C_0=y
#CONFIG_I2C_1=y
CONFIG_SENSOR=y
CONFIG_ICM20948=y
CONFIG_ICM20948_I2C_AD0=n
#CONFIG_BME280=y
CONFIG_ICM20948_ACCEL_RANGE_4G=y
CONFIG_ICM20948_GYRO_RANGE_1000=y

CONFIG_SPI=y
CONFIG_SPI_1=y
CONFIG_SPI_2=y
CONFIG_LED_STRIP=y
CONFIG_WS2812_STRIP=y
```
